## drivers/Kconfig
```kconfig
# SPDX-License-Identifier: GPL-2.0
menu "Device Drivers"

source "drivers/amba/Kconfig"
source "drivers/base/Kconfig"
source "drivers/bus/Kconfig"
source "drivers/of/Kconfig"
source "drivers/mtd/Kconfig"
source "drivers/net/Kconfig"
source "drivers/char/Kconfig"
source "drivers/watchdog/Kconfig"
source "drivers/dma/Kconfig"
source "drivers/firmware/Kconfig"
source "drivers/virt/Kconfig"
source "drivers/virtio/Kconfig"
source "drivers/hv/Kconfig"
source "drivers/xen/Kconfig"
source "drivers/clk/Kconfig"
source "drivers/clocksource/Kconfig"
source "drivers/soc/Kconfig"
source "drivers/irqchip/Kconfig"
source "drivers/reset/Kconfig"

endmenu
```
